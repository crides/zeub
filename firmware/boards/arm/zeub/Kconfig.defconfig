## firmware/boards/arm/zeub/Kconfig.defconfig
```kconfig
# Zeub board configuration

# Copyright (c) 2020 Tobias Svehagen
# SPDX-License-Identifier: Apache-2.0

if BOARD_ZEUB

config BOARD
	default "zeub"

config BT_CTLR
	default BT

endif # BOARD_ZEUB
```

## firmware/boards/arm/zeub/zeub_defconfig
```kconfig
# SPDX-License-Identifier: Apache-2.0

CONFIG_SOC_SERIES_NRF52X=y
CONFIG_SOC_NRF52840_QIAA=y
CONFIG_BOARD_ZEUB=y
CONFIG_PINCTRL=y

# Enable MPU
CONFIG_ARM_MPU=y

# enable GPIO
CONFIG_GPIO=y

# additional board options
CONFIG_GPIO_AS_PINRESET=y
CONFIG_LOG_PROCESS_THREAD_SLEEP_MS=100
CONFIG_LOG_PROCESS_THREAD_STACK_SIZE=4096
CONFIG_HW_STACK_PROTECTION=y
CONFIG_MAIN_STACK_SIZE=4096
CONFIG_ZEUB_DISPLAY_THREAD_STACK_SIZE=4096
CONFIG_USB_DEVICE_STACK=y
CONFIG_USB_DEVICE_AUDIO=y
CONFIG_I2S=y
CONFIG_USB_NRFX_EVT_QUEUE_SIZE=64
```

## firmware/drivers/is31/Kconfig
```kconfig
# Copyright (c) 2020 The ZMK Contributors
# SPDX-License-Identifier: MIT

config IS31FL3729
    bool "IS31FL3729 LED Matrix driver"
    depends on I2C
    depends on LED_STRIP
    help
        Enable an IS31FL3729 LED Matrix driver.
        The IS31FL3729 is a general purpose 16x8 or 15x9 LED Matrix
        programmed via an I2C compatible interface. Each LED can be dimmed
        individually with 8-bit PWM data and 8-bit scaling data which
        allows 256 steps of linear PWM dimming and 256 steps of DC current
        adjustable level.
```
